## main/Kconfig.cli
```kconfig
menu "CLI Controller Log Level"
    choice CLI_CTRL_LOG_LEVEL
        bool "CLI log verbosity"
        default CLI_CTRL_LOG_DEFAULT_LEVEL_INFO
        help
            Specify how much output to see in logs by default.
            You can set lower verbosity level at runtime using
            esp_log_level_set() function if LOG_DYNAMIC_LEVEL_CONTROL
            is enabled.

            By default, this setting limits which log statements
            are compiled into the program. For example, selecting
            "Warning" would mean that changing log level to "Debug"
            at runtime will not be possible. To allow increasing log
            level above the default at runtime, see the next option.

        config CLI_CTRL_LOG_DEFAULT_LEVEL_NONE
            bool "No output"
        config CLI_CTRL_LOG_DEFAULT_LEVEL_ERROR
            bool "Error"
        config CLI_CTRL_LOG_DEFAULT_LEVEL_WARN
            bool "Warning"
        config CLI_CTRL_LOG_DEFAULT_LEVEL_INFO
            bool "Info"
        config CLI_CTRL_LOG_DEFAULT_LEVEL_DEBUG
            bool "Debug"
        config CLI_CTRL_LOG_DEFAULT_LEVEL_VERBOSE
            bool "Verbose"
    endchoice

    config CLI_CTRL_LOG_LEVEL
        int
        default 0 if CLI_CTRL_LOG_DEFAULT_LEVEL_NONE
        default 1 if CLI_CTRL_LOG_DEFAULT_LEVEL_ERROR
        default 2 if CLI_CTRL_LOG_DEFAULT_LEVEL_WARN
        default 3 if CLI_CTRL_LOG_DEFAULT_LEVEL_INFO
        default 4 if CLI_CTRL_LOG_DEFAULT_LEVEL_DEBUG
        default 5 if CLI_CTRL_LOG_DEFAULT_LEVEL_VERBOSE
endmenu
```

## main/Kconfig.eth
```kconfig
menu "ETH Controller Log Level"
    choice ETH_CTRL_LOG_LEVEL
        bool "ETH log verbosity"
        default ETH_CTRL_LOG_DEFAULT_LEVEL_INFO
        help
            Specify how much output to see in logs by default.
            You can set lower verbosity level at runtime using
            esp_log_level_set() function if LOG_DYNAMIC_LEVEL_CONTROL
            is enabled.

            By default, this setting limits which log statements
            are compiled into the program. For example, selecting
            "Warning" would mean that changing log level to "Debug"
            at runtime will not be possible. To allow increasing log
            level above the default at runtime, see the next option.

        config ETH_CTRL_LOG_DEFAULT_LEVEL_NONE
            bool "No output"
        config ETH_CTRL_LOG_DEFAULT_LEVEL_ERROR
            bool "Error"
        config ETH_CTRL_LOG_DEFAULT_LEVEL_WARN
            bool "Warning"
        config ETH_CTRL_LOG_DEFAULT_LEVEL_INFO
            bool "Info"
        config ETH_CTRL_LOG_DEFAULT_LEVEL_DEBUG
            bool "Debug"
        config ETH_CTRL_LOG_DEFAULT_LEVEL_VERBOSE
            bool "Verbose"
    endchoice

    config ETH_CTRL_LOG_LEVEL
        int
        default 0 if ETH_CTRL_LOG_DEFAULT_LEVEL_NONE
        default 1 if ETH_CTRL_LOG_DEFAULT_LEVEL_ERROR
        default 2 if ETH_CTRL_LOG_DEFAULT_LEVEL_WARN
        default 3 if ETH_CTRL_LOG_DEFAULT_LEVEL_INFO
        default 4 if ETH_CTRL_LOG_DEFAULT_LEVEL_DEBUG
        default 5 if ETH_CTRL_LOG_DEFAULT_LEVEL_VERBOSE
endmenu
```

## main/Kconfig.level
```kconfig
menu "Log Level"

    orsource "./Kconfig.main"
    orsource "./Kconfig.mgr"

    if ETH_CTRL_ENABLE
        orsource "./Kconfig.eth"
    endif

    if MQTT_CTRL_ENABLE
        orsource "./Kconfig.mqtt"
    endif

    if GPIO_CTRL_ENABLE    
        orsource "./Kconfig.gpio"
    endif

    if POWER_CTRL_ENABLE    
        orsource "./Kconfig.power"
    endif

    if RELAY_CTRL_ENABLE
        orsource "./Kconfig.relay"
    endif

    if CFG_CTRL_ENABLE
        orsource "./Kconfig.cfg"
    endif

    if SYS_CTRL_ENABLE
        orsource "./Kconfig.sys"
    endif

    if CLI_CTRL_ENABLE
        orsource "./Kconfig.cli"
    endif

endmenu
```

## main/Kconfig.main
```kconfig
menu "MAIN"

    choice MAIN_LOG_LEVEL
        bool "Log level"
        default MAIN_LOG_DEFAULT_LEVEL_INFO
        help
            Specify how much output to see in logs by default.
            You can set lower verbosity level at runtime using
            esp_log_level_set() function if LOG_DYNAMIC_LEVEL_CONTROL
            is enabled.

            By default, this setting limits which log statements
            are compiled into the program. For example, selecting
            "Warning" would mean that changing log level to "Debug"
            at runtime will not be possible. To allow increasing log
            level above the default at runtime, see the next option.

        config MAIN_LOG_DEFAULT_LEVEL_NONE
            bool "No output"
        config MAIN_LOG_DEFAULT_LEVEL_ERROR
            bool "Error"
        config MAIN_LOG_DEFAULT_LEVEL_WARN
            bool "Warning"
        config MAIN_LOG_DEFAULT_LEVEL_INFO
            bool "Info"
        config MAIN_LOG_DEFAULT_LEVEL_DEBUG
            bool "Debug"
        config MAIN_LOG_DEFAULT_LEVEL_VERBOSE
            bool "Verbose"
    endchoice

    config MAIN_LOG_LEVEL
        int
        default 0 if MAIN_LOG_DEFAULT_LEVEL_NONE
        default 1 if MAIN_LOG_DEFAULT_LEVEL_ERROR
        default 2 if MAIN_LOG_DEFAULT_LEVEL_WARN
        default 3 if MAIN_LOG_DEFAULT_LEVEL_INFO
        default 4 if MAIN_LOG_DEFAULT_LEVEL_DEBUG
        default 5 if MAIN_LOG_DEFAULT_LEVEL_VERBOSE

    config MAIN_MEMORY_SNAPSHOT_ENABLE
        bool "Enable memory snapshot logs"
        default n
        help
            Enable heap snapshot logging at selected checkpoints.

    config MAIN_MEMORY_PERIODIC_MONITOR_ENABLE
        bool "Enable periodic memory monitor task"
        default n
        depends on MAIN_MEMORY_SNAPSHOT_ENABLE
        help
            Start a background task that logs memory usage periodically.

    config MAIN_MEMORY_MONITOR_PERIOD_MS
        int "Memory monitor period [ms]"
        range 1000 600000
        default 10000
        depends on MAIN_MEMORY_PERIODIC_MONITOR_ENABLE

    config MAIN_MEMORY_MONITOR_TASK_STACK
        int "Memory monitor task stack [bytes]"
        range 2048 8192
        default 3072
        depends on MAIN_MEMORY_PERIODIC_MONITOR_ENABLE

    config MAIN_MEMORY_MONITOR_TASK_PRIORITY
        int "Memory monitor task priority"
        range 1 10
        default 2
        depends on MAIN_MEMORY_PERIODIC_MONITOR_ENABLE

endmenu
```

## main/Kconfig.mgr
```kconfig
menu "Manager"

    choice MGR_CTRL_LOG_LEVEL
        bool "Log level"
        default MGR_CTRL_LOG_DEFAULT_LEVEL_INFO
        help
            Specify how much output to see in logs by default.
            You can set lower verbosity level at runtime using
            esp_log_level_set() function if LOG_DYNAMIC_LEVEL_CONTROL
            is enabled.

            By default, this setting limits which log statements
            are compiled into the program. For example, selecting
            "Warning" would mean that changing log level to "Debug"
            at runtime will not be possible. To allow increasing log
            level above the default at runtime, see the next option.

        config MGR_CTRL_LOG_DEFAULT_LEVEL_NONE
            bool "No output"
        config MGR_CTRL_LOG_DEFAULT_LEVEL_ERROR
            bool "Error"
        config MGR_CTRL_LOG_DEFAULT_LEVEL_WARN
            bool "Warning"
        config MGR_CTRL_LOG_DEFAULT_LEVEL_INFO
            bool "Info"
        config MGR_CTRL_LOG_DEFAULT_LEVEL_DEBUG
            bool "Debug"
        config MGR_CTRL_LOG_DEFAULT_LEVEL_VERBOSE
            bool "Verbose"
    endchoice

    config MGR_CTRL_LOG_LEVEL
        int
        default 0 if MGR_CTRL_LOG_DEFAULT_LEVEL_NONE
        default 1 if MGR_CTRL_LOG_DEFAULT_LEVEL_ERROR
        default 2 if MGR_CTRL_LOG_DEFAULT_LEVEL_WARN
        default 3 if MGR_CTRL_LOG_DEFAULT_LEVEL_INFO
        default 4 if MGR_CTRL_LOG_DEFAULT_LEVEL_DEBUG
        default 5 if MGR_CTRL_LOG_DEFAULT_LEVEL_VERBOSE

endmenu
```

## main/Kconfig.power
```kconfig
menu "POWER Controller Log Level"
    choice POWER_CTRL_LOG_LEVEL
        bool "POWER log verbosity"
        default POWER_CTRL_LOG_DEFAULT_LEVEL_INFO
        help
            Specify how much output to see in logs by default.
            You can set lower verbosity level at runtime using
            esp_log_level_set() function if LOG_DYNAMIC_LEVEL_CONTROL
            is enabled.

            By default, this setting limits which log statements
            are compiled into the program. For example, selecting
            "Warning" would mean that changing log level to "Debug"
            at runtime will not be possible. To allow increasing log
            level above the default at runtime, see the next option.

        config POWER_CTRL_LOG_DEFAULT_LEVEL_NONE
            bool "No output"
        config POWER_CTRL_LOG_DEFAULT_LEVEL_ERROR
            bool "Error"
        config POWER_CTRL_LOG_DEFAULT_LEVEL_WARN
            bool "Warning"
        config POWER_CTRL_LOG_DEFAULT_LEVEL_INFO
            bool "Info"
        config POWER_CTRL_LOG_DEFAULT_LEVEL_DEBUG
            bool "Debug"
        config POWER_CTRL_LOG_DEFAULT_LEVEL_VERBOSE
            bool "Verbose"
    endchoice

    config POWER_CTRL_LOG_LEVEL
        int
        default 0 if POWER_CTRL_LOG_DEFAULT_LEVEL_NONE
        default 1 if POWER_CTRL_LOG_DEFAULT_LEVEL_ERROR
        default 2 if POWER_CTRL_LOG_DEFAULT_LEVEL_WARN
        default 3 if POWER_CTRL_LOG_DEFAULT_LEVEL_INFO
        default 4 if POWER_CTRL_LOG_DEFAULT_LEVEL_DEBUG
        default 5 if POWER_CTRL_LOG_DEFAULT_LEVEL_VERBOSE
endmenu
```

## main/Kconfig.projbuild
```kconfig
menu "ESP32 - Platform"

    orsource "Kconfig.main"
    orsource "Kconfig.mgr"
    orsource "Kconfig.tools"

    orsource "../modules/Kconfig.inc"

endmenu
```

## main/Kconfig.relay
```kconfig
menu "RELAY Controller Log Level"
    choice RELAY_CTRL_LOG_LEVEL
        bool "RELAY log verbosity"
        default RELAY_CTRL_LOG_DEFAULT_LEVEL_INFO
        help
            Specify how much output to see in logs by default.
            You can set lower verbosity level at runtime using
            esp_log_level_set() function if LOG_DYNAMIC_LEVEL_CONTROL
            is enabled.

            By default, this setting limits which log statements
            are compiled into the program. For example, selecting
            "Warning" would mean that changing log level to "Debug"
            at runtime will not be possible. To allow increasing log
            level above the default at runtime, see the next option.

        config RELAY_CTRL_LOG_DEFAULT_LEVEL_NONE
            bool "No output"
        config RELAY_CTRL_LOG_DEFAULT_LEVEL_ERROR
            bool "Error"
        config RELAY_CTRL_LOG_DEFAULT_LEVEL_WARN
            bool "Warning"
        config RELAY_CTRL_LOG_DEFAULT_LEVEL_INFO
            bool "Info"
        config RELAY_CTRL_LOG_DEFAULT_LEVEL_DEBUG
            bool "Debug"
        config RELAY_CTRL_LOG_DEFAULT_LEVEL_VERBOSE
            bool "Verbose"
    endchoice

    config RELAY_CTRL_LOG_LEVEL
        int
        default 0 if RELAY_CTRL_LOG_DEFAULT_LEVEL_NONE
        default 1 if RELAY_CTRL_LOG_DEFAULT_LEVEL_ERROR
        default 2 if RELAY_CTRL_LOG_DEFAULT_LEVEL_WARN
        default 3 if RELAY_CTRL_LOG_DEFAULT_LEVEL_INFO
        default 4 if RELAY_CTRL_LOG_DEFAULT_LEVEL_DEBUG
        default 5 if RELAY_CTRL_LOG_DEFAULT_LEVEL_VERBOSE
endmenu
```

## main/Kconfig.tools
```kconfig
menu "Tools"

    choice TOOLS_LOG_LEVEL
        bool "Log level"
        default TOOLS_LOG_DEFAULT_LEVEL_INFO
        help
            Specify how much output to see in logs by default.
            You can set lower verbosity level at runtime using
            esp_log_level_set() function if LOG_DYNAMIC_LEVEL_CONTROL
            is enabled.

            By default, this setting limits which log statements
            are compiled into the program. For example, selecting
            "Warning" would mean that changing log level to "Debug"
            at runtime will not be possible. To allow increasing log
            level above the default at runtime, see the next option.

        config TOOLS_LOG_DEFAULT_LEVEL_NONE
            bool "No output"
        config TOOLS_LOG_DEFAULT_LEVEL_ERROR
            bool "Error"
        config TOOLS_LOG_DEFAULT_LEVEL_WARN
            bool "Warning"
        config TOOLS_LOG_DEFAULT_LEVEL_INFO
            bool "Info"
        config TOOLS_LOG_DEFAULT_LEVEL_DEBUG
            bool "Debug"
        config TOOLS_LOG_DEFAULT_LEVEL_VERBOSE
            bool "Verbose"
    endchoice

    config TOOLS_LOG_LEVEL
        int
        default 0 if TOOLS_LOG_DEFAULT_LEVEL_NONE
        default 1 if TOOLS_LOG_DEFAULT_LEVEL_ERROR
        default 2 if TOOLS_LOG_DEFAULT_LEVEL_WARN
        default 3 if TOOLS_LOG_DEFAULT_LEVEL_INFO
        default 4 if TOOLS_LOG_DEFAULT_LEVEL_DEBUG
        default 5 if TOOLS_LOG_DEFAULT_LEVEL_VERBOSE

endmenu
```

## modules/Kconfig.inc
```kconfig
orsource "eth_ctrl/Kconfig.inc"
orsource "mqtt_ctrl/Kconfig.inc"
orsource "cfg_ctrl/Kconfig.inc"
orsource "cli_ctrl/Kconfig.inc"
orsource "gpio_ctrl/Kconfig.inc"
orsource "relay_ctrl/Kconfig.inc"
orsource "lcd_ctrl/Kconfig.inc"
orsource "sys_ctrl/Kconfig.inc"
orsource "sensors_ctrl/Kconfig.inc"
orsource "template_ctrl/Kconfig.inc"
```

## modules/gpio_ctrl/Kconfig.inc
```kconfig
menu "GPIO Controller"

    config GPIO_CTRL_ENABLE
        bool "Enable GPIO Controller"
        default "n"
        help
            Enable GPIO Controller to use by the Manager

    choice GPIO_CTRL_LOG_LEVEL
        bool "Log level"
        default GPIO_CTRL_LOG_DEFAULT_LEVEL_INFO
        help
            Specify how much output to see in logs by default.
            You can set lower verbosity level at runtime using
            esp_log_level_set() function if LOG_DYNAMIC_LEVEL_CONTROL
            is enabled.

            By default, this setting limits which log statements
            are compiled into the program. For example, selecting
            "Warning" would mean that changing log level to "Debug"
            at runtime will not be possible. To allow increasing log
            level above the default at runtime, see the next option.

        config GPIO_CTRL_LOG_DEFAULT_LEVEL_NONE
            bool "No output"
        config GPIO_CTRL_LOG_DEFAULT_LEVEL_ERROR
            bool "Error"
        config GPIO_CTRL_LOG_DEFAULT_LEVEL_WARN
            bool "Warning"
        config GPIO_CTRL_LOG_DEFAULT_LEVEL_INFO
            bool "Info"
        config GPIO_CTRL_LOG_DEFAULT_LEVEL_DEBUG
            bool "Debug"
        config GPIO_CTRL_LOG_DEFAULT_LEVEL_VERBOSE
            bool "Verbose"
    endchoice

    config GPIO_CTRL_LOG_LEVEL
        int
        default 0 if GPIO_CTRL_LOG_DEFAULT_LEVEL_NONE
        default 1 if GPIO_CTRL_LOG_DEFAULT_LEVEL_ERROR
        default 2 if GPIO_CTRL_LOG_DEFAULT_LEVEL_WARN
        default 3 if GPIO_CTRL_LOG_DEFAULT_LEVEL_INFO
        default 4 if GPIO_CTRL_LOG_DEFAULT_LEVEL_DEBUG
        default 5 if GPIO_CTRL_LOG_DEFAULT_LEVEL_VERBOSE

endmenu
```
