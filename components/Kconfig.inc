## modules/lcd_ctrl/Kconfig.inc
```kconfig
menu "LCD Controller"

    config LCD_CTRL_ENABLE
        bool "Enable LCD Controller"
        depends on IDF_TARGET_ESP32
        default "n"
        help
            Enable LCD Controller to use by the Manager.
            This module is supported only for ESP32 target.

    choice LCD_CTRL_LOG_LEVEL
        bool "LCD Controller Log level"
        default LCD_CTRL_LOG_DEFAULT_LEVEL_INFO
        help
            Specify how much output to see in logs by default.

        config LCD_CTRL_LOG_DEFAULT_LEVEL_NONE
            bool "No output"
        config LCD_CTRL_LOG_DEFAULT_LEVEL_ERROR
            bool "Error"
        config LCD_CTRL_LOG_DEFAULT_LEVEL_WARN
            bool "Warning"
        config LCD_CTRL_LOG_DEFAULT_LEVEL_INFO
            bool "Info"
        config LCD_CTRL_LOG_DEFAULT_LEVEL_DEBUG
            bool "Debug"
        config LCD_CTRL_LOG_DEFAULT_LEVEL_VERBOSE
            bool "Verbose"
    endchoice

    choice LCD_HELPER_LOG_LEVEL
        bool "LCD Helper Log level"
        default LCD_HELPER_LOG_DEFAULT_LEVEL_INFO
        help
            Specify how much output to see in logs by default.

        config LCD_HELPER_LOG_DEFAULT_LEVEL_NONE
            bool "No output"
        config LCD_HELPER_LOG_DEFAULT_LEVEL_ERROR
            bool "Error"
        config LCD_HELPER_LOG_DEFAULT_LEVEL_WARN
            bool "Warning"
        config LCD_HELPER_LOG_DEFAULT_LEVEL_INFO
            bool "Info"
        config LCD_HELPER_LOG_DEFAULT_LEVEL_DEBUG
            bool "Debug"
        config LCD_HELPER_LOG_DEFAULT_LEVEL_VERBOSE
            bool "Verbose"
    endchoice

    choice LCD_HW_LOG_LEVEL
        bool "LCD HW Log level"
        default LCD_HW_LOG_DEFAULT_LEVEL_INFO
        help
            Specify how much output to see in logs by default.

        config LCD_HW_LOG_DEFAULT_LEVEL_NONE
            bool "No output"
        config LCD_HW_LOG_DEFAULT_LEVEL_ERROR
            bool "Error"
        config LCD_HW_LOG_DEFAULT_LEVEL_WARN
            bool "Warning"
        config LCD_HW_LOG_DEFAULT_LEVEL_INFO
            bool "Info"
        config LCD_HW_LOG_DEFAULT_LEVEL_DEBUG
            bool "Debug"
        config LCD_HW_LOG_DEFAULT_LEVEL_VERBOSE
            bool "Verbose"
    endchoice

    choice LCD_ILI9341V_LOG_LEVEL
        bool "LCD ILI9341V Log level"
        default LCD_ILI9341V_LOG_DEFAULT_LEVEL_INFO
        help
            Specify how much output to see in logs by default.

        config LCD_ILI9341V_LOG_DEFAULT_LEVEL_NONE
            bool "No output"
        config LCD_ILI9341V_LOG_DEFAULT_LEVEL_ERROR
            bool "Error"
        config LCD_ILI9341V_LOG_DEFAULT_LEVEL_WARN
            bool "Warning"
        config LCD_ILI9341V_LOG_DEFAULT_LEVEL_INFO
            bool "Info"
        config LCD_ILI9341V_LOG_DEFAULT_LEVEL_DEBUG
            bool "Debug"
        config LCD_ILI9341V_LOG_DEFAULT_LEVEL_VERBOSE
            bool "Verbose"
    endchoice

    choice LCD_NS2009_LOG_LEVEL
        bool "LCD NS2009 Log level"
        default LCD_NS2009_LOG_DEFAULT_LEVEL_INFO
        help
            Specify how much output to see in logs by default.

        config LCD_NS2009_LOG_DEFAULT_LEVEL_NONE
            bool "No output"
        config LCD_NS2009_LOG_DEFAULT_LEVEL_ERROR
            bool "Error"
        config LCD_NS2009_LOG_DEFAULT_LEVEL_WARN
            bool "Warning"
        config LCD_NS2009_LOG_DEFAULT_LEVEL_INFO
            bool "Info"
        config LCD_NS2009_LOG_DEFAULT_LEVEL_DEBUG
            bool "Debug"
        config LCD_NS2009_LOG_DEFAULT_LEVEL_VERBOSE
            bool "Verbose"
    endchoice

    menu "NS2009 Touch Calibration"

        config LCD_NS2009_I2C_PORT
            int "I2C port"
            range 0 1
            default 0
            help
                ESP-IDF I2C master port used by NS2009.

        config LCD_NS2009_SDA_GPIO
            int "SDA GPIO"
            range -1 48
            default 13
            help
                GPIO used as I2C SDA for NS2009 touch controller.

        config LCD_NS2009_SCL_GPIO
            int "SCL GPIO"
            range -1 48
            default 16
            help
                GPIO used as I2C SCL for NS2009 touch controller.

        config LCD_NS2009_I2C_FREQ_HZ
            int "I2C frequency [Hz]"
            range 10000 400000
            default 100000
            help
                I2C clock speed for NS2009 communication.

        config LCD_NS2009_TOUCH_THRESHOLD
            int "Touch pressure threshold (Z1)"
            range 1 4095
            default 20
            help
                Minimum Z1 value required to report touch as pressed.

        config LCD_NS2009_REQUIRE_PRESSURE
            bool "Require pressure threshold for touch detect"
            default n
            help
                If enabled, touch is reported only when Z1 is above threshold.
                If disabled, X/Y raw range is used as the main touch presence check.

        config LCD_NS2009_RAW_MIN_X
            int "Raw X minimum"
            range 0 4095
            default 180
            help
                Minimum raw X value for calibration mapping.

        config LCD_NS2009_RAW_MAX_X
            int "Raw X maximum"
            range 0 4095
            default 3900
            help
                Maximum raw X value for calibration mapping.

        config LCD_NS2009_RAW_MIN_Y
            int "Raw Y minimum"
            range 0 4095
            default 220
            help
                Minimum raw Y value for calibration mapping.

        config LCD_NS2009_RAW_MAX_Y
            int "Raw Y maximum"
            range 0 4095
            default 3900
            help
                Maximum raw Y value for calibration mapping.

        config LCD_NS2009_SWAP_XY
            bool "Swap X and Y axes"
            default n
            help
                Swap axes if touch orientation is rotated by 90 degrees.

        config LCD_NS2009_INVERT_X
            bool "Invert X axis"
            default n
            help
                Invert calibrated X axis direction.

        config LCD_NS2009_INVERT_Y
            bool "Invert Y axis"
            default n
            help
                Invert calibrated Y axis direction.

    endmenu

    choice LCD_UI_ROTATION
        bool "LCD UI rotation"
        default LCD_UI_ROTATION_0
        help
            Rotate LVGL UI to match physical panel mounting orientation.

        config LCD_UI_ROTATION_0
            bool "0 degrees"

        config LCD_UI_ROTATION_90
            bool "90 degrees"

        config LCD_UI_ROTATION_180
            bool "180 degrees"

        config LCD_UI_ROTATION_270
            bool "270 degrees"
    endchoice

    config LCD_CTRL_LOG_LEVEL
        int
        default 0 if LCD_CTRL_LOG_DEFAULT_LEVEL_NONE
        default 1 if LCD_CTRL_LOG_DEFAULT_LEVEL_ERROR
        default 2 if LCD_CTRL_LOG_DEFAULT_LEVEL_WARN
        default 3 if LCD_CTRL_LOG_DEFAULT_LEVEL_INFO
        default 4 if LCD_CTRL_LOG_DEFAULT_LEVEL_DEBUG
        default 5 if LCD_CTRL_LOG_DEFAULT_LEVEL_VERBOSE

    config LCD_HELPER_LOG_LEVEL
        int
        default 0 if LCD_HELPER_LOG_DEFAULT_LEVEL_NONE
        default 1 if LCD_HELPER_LOG_DEFAULT_LEVEL_ERROR
        default 2 if LCD_HELPER_LOG_DEFAULT_LEVEL_WARN
        default 3 if LCD_HELPER_LOG_DEFAULT_LEVEL_INFO
        default 4 if LCD_HELPER_LOG_DEFAULT_LEVEL_DEBUG
        default 5 if LCD_HELPER_LOG_DEFAULT_LEVEL_VERBOSE

    config LCD_HW_LOG_LEVEL
        int
        default 0 if LCD_HW_LOG_DEFAULT_LEVEL_NONE
        default 1 if LCD_HW_LOG_DEFAULT_LEVEL_ERROR
        default 2 if LCD_HW_LOG_DEFAULT_LEVEL_WARN
        default 3 if LCD_HW_LOG_DEFAULT_LEVEL_INFO
        default 4 if LCD_HW_LOG_DEFAULT_LEVEL_DEBUG
        default 5 if LCD_HW_LOG_DEFAULT_LEVEL_VERBOSE

    config LCD_ILI9341V_LOG_LEVEL
        int
        default 0 if LCD_ILI9341V_LOG_DEFAULT_LEVEL_NONE
        default 1 if LCD_ILI9341V_LOG_DEFAULT_LEVEL_ERROR
        default 2 if LCD_ILI9341V_LOG_DEFAULT_LEVEL_WARN
        default 3 if LCD_ILI9341V_LOG_DEFAULT_LEVEL_INFO
        default 4 if LCD_ILI9341V_LOG_DEFAULT_LEVEL_DEBUG
        default 5 if LCD_ILI9341V_LOG_DEFAULT_LEVEL_VERBOSE

    config LCD_NS2009_LOG_LEVEL
        int
        default 0 if LCD_NS2009_LOG_DEFAULT_LEVEL_NONE
        default 1 if LCD_NS2009_LOG_DEFAULT_LEVEL_ERROR
        default 2 if LCD_NS2009_LOG_DEFAULT_LEVEL_WARN
        default 3 if LCD_NS2009_LOG_DEFAULT_LEVEL_INFO
        default 4 if LCD_NS2009_LOG_DEFAULT_LEVEL_DEBUG
        default 5 if LCD_NS2009_LOG_DEFAULT_LEVEL_VERBOSE


endmenu
```

## modules/sensor_ctrl/Kconfig.inc
```kconfig
menu "Sensor Controller"

    config SENSOR_CTRL_ENABLE
        bool "Enable Sensor Controller"
        default "n"
        help
            Enable Sensor Controller to use by the Manager

        choice SENSOR_CTRL_LOG_LEVEL
            bool "Log level"
            default SENSOR_CTRL_LOG_DEFAULT_LEVEL_INFO
            help
                Specify how much output to see in logs by default.
                You can set lower verbosity level at runtime using
                esp_log_level_set() function if LOG_DYNAMIC_LEVEL_CONTROL
                is enabled.

            config SENSOR_CTRL_LOG_DEFAULT_LEVEL_NONE
                bool "No output"
            config SENSOR_CTRL_LOG_DEFAULT_LEVEL_ERROR
                bool "Error"
            config SENSOR_CTRL_LOG_DEFAULT_LEVEL_WARN
                bool "Warning"
            config SENSOR_CTRL_LOG_DEFAULT_LEVEL_INFO
                bool "Info"
            config SENSOR_CTRL_LOG_DEFAULT_LEVEL_DEBUG
                bool "Debug"
            config SENSOR_CTRL_LOG_DEFAULT_LEVEL_VERBOSE
                bool "Verbose"
        endchoice

        config SENSOR_CTRL_LOG_LEVEL
            int
            default 0 if SENSOR_CTRL_LOG_DEFAULT_LEVEL_NONE
            default 1 if SENSOR_CTRL_LOG_DEFAULT_LEVEL_ERROR
            default 2 if SENSOR_CTRL_LOG_DEFAULT_LEVEL_WARN
            default 3 if SENSOR_CTRL_LOG_DEFAULT_LEVEL_INFO
            default 4 if SENSOR_CTRL_LOG_DEFAULT_LEVEL_DEBUG
            default 5 if SENSOR_CTRL_LOG_DEFAULT_LEVEL_VERBOSE

    config SENSOR_TSL2561_ENABLE
        bool "Enable Light Sensor TSL2561"
        default "n"
        help
            Enable Light Sensor TSL2561 to use in Sensors Controller

        choice SENSOR_TSL2561_LOG_LEVEL
            bool "Log level"
            default SENSOR_TSL2561_LOG_DEFAULT_LEVEL_INFO
            help
                Specify how much output to see in logs by default.
                You can set lower verbosity level at runtime using
                esp_log_level_set() function if LOG_DYNAMIC_LEVEL_CONTROL
                is enabled.

            config SENSOR_TSL2561_LOG_DEFAULT_LEVEL_NONE
                bool "No output"
            config SENSOR_TSL2561_LOG_DEFAULT_LEVEL_ERROR
                bool "Error"
            config SENSOR_TSL2561_LOG_DEFAULT_LEVEL_WARN
                bool "Warning"
            config SENSOR_TSL2561_LOG_DEFAULT_LEVEL_INFO
                bool "Info"
            config SENSOR_TSL2561_LOG_DEFAULT_LEVEL_DEBUG
                bool "Debug"
            config SENSOR_TSL2561_LOG_DEFAULT_LEVEL_VERBOSE
                bool "Verbose"
        endchoice

        config SENSOR_TSL2561_LOG_LEVEL
            int
            default 0 if SENSOR_TSL2561_LOG_DEFAULT_LEVEL_NONE
            default 1 if SENSOR_TSL2561_LOG_DEFAULT_LEVEL_ERROR
            default 2 if SENSOR_TSL2561_LOG_DEFAULT_LEVEL_WARN
            default 3 if SENSOR_TSL2561_LOG_DEFAULT_LEVEL_INFO
            default 4 if SENSOR_TSL2561_LOG_DEFAULT_LEVEL_DEBUG
            default 5 if SENSOR_TSL2561_LOG_DEFAULT_LEVEL_VERBOSE

endmenu
```

## modules/sensors_ctrl/Kconfig.inc
```kconfig
menu "Sensors Controller"

    config SENSORS_CTRL_ENABLE
        bool "Enable Sensors Controller"
        default "n"
        help
            Enable Sensors Controller to use by the Manager

        choice SENSORS_CTRL_LOG_LEVEL
            depends on SENSORS_CTRL_ENABLE
            bool "Log level"
            default SENSORS_CTRL_LOG_DEFAULT_LEVEL_INFO
            help
                Specify how much output to see in logs by default.
                You can set lower verbosity level at runtime using
                esp_log_level_set() function if LOG_DYNAMIC_LEVEL_CONTROL
                is enabled.

            config SENSORS_CTRL_LOG_DEFAULT_LEVEL_NONE
                bool "No output"
            config SENSORS_CTRL_LOG_DEFAULT_LEVEL_ERROR
                bool "Error"
            config SENSORS_CTRL_LOG_DEFAULT_LEVEL_WARN
                bool "Warning"
            config SENSORS_CTRL_LOG_DEFAULT_LEVEL_INFO
                bool "Info"
            config SENSORS_CTRL_LOG_DEFAULT_LEVEL_DEBUG
                bool "Debug"
            config SENSORS_CTRL_LOG_DEFAULT_LEVEL_VERBOSE
                bool "Verbose"
        endchoice

        config SENSORS_CTRL_LOG_LEVEL
            int
            default 0 if SENSORS_CTRL_LOG_DEFAULT_LEVEL_NONE
            default 1 if SENSORS_CTRL_LOG_DEFAULT_LEVEL_ERROR
            default 2 if SENSORS_CTRL_LOG_DEFAULT_LEVEL_WARN
            default 3 if SENSORS_CTRL_LOG_DEFAULT_LEVEL_INFO
            default 4 if SENSORS_CTRL_LOG_DEFAULT_LEVEL_DEBUG
            default 5 if SENSORS_CTRL_LOG_DEFAULT_LEVEL_VERBOSE

    config SENSOR_TSL2561_ENABLE
        depends on SENSORS_CTRL_ENABLE
        bool "Enable Light Sensor TSL2561"
        default "n"
        help
            Enable Light Sensor TSL2561 to use in Sensors Controller

        choice SENSOR_TSL2561_LOG_LEVEL
            depends on SENSOR_TSL2561_ENABLE
            bool "Log level"
            default SENSOR_TSL2561_LOG_DEFAULT_LEVEL_INFO
            help
                Specify how much output to see in logs by default.
                You can set lower verbosity level at runtime using
                esp_log_level_set() function if LOG_DYNAMIC_LEVEL_CONTROL
                is enabled.

            config SENSOR_TSL2561_LOG_DEFAULT_LEVEL_NONE
                bool "No output"
            config SENSOR_TSL2561_LOG_DEFAULT_LEVEL_ERROR
                bool "Error"
            config SENSOR_TSL2561_LOG_DEFAULT_LEVEL_WARN
                bool "Warning"
            config SENSOR_TSL2561_LOG_DEFAULT_LEVEL_INFO
                bool "Info"
            config SENSOR_TSL2561_LOG_DEFAULT_LEVEL_DEBUG
                bool "Debug"
            config SENSOR_TSL2561_LOG_DEFAULT_LEVEL_VERBOSE
                bool "Verbose"
        endchoice

        config SENSOR_TSL2561_LOG_LEVEL
            int
            default 0 if SENSOR_TSL2561_LOG_DEFAULT_LEVEL_NONE
            default 1 if SENSOR_TSL2561_LOG_DEFAULT_LEVEL_ERROR
            default 2 if SENSOR_TSL2561_LOG_DEFAULT_LEVEL_WARN
            default 3 if SENSOR_TSL2561_LOG_DEFAULT_LEVEL_INFO
            default 4 if SENSOR_TSL2561_LOG_DEFAULT_LEVEL_DEBUG
            default 5 if SENSOR_TSL2561_LOG_DEFAULT_LEVEL_VERBOSE

endmenu
```
