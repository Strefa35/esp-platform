## components/Kconfig.inc
```kconfig
orsource "mgr_ctrl/Kconfig.inc"

orsource "eth_ctrl/Kconfig.inc"
orsource "mgtt_ctrl/Kconfig.inc"

orsource "cfg_ctrl/Kconfig.inc"
orsource "cli_ctrl/Kconfig.inc"

orsource "gpio_ctrl/Kconfig.inc"
orsource "relay_ctrl/Kconfig.inc"

orsource "lcd_ctrl/Kconfig.inc"

orsource "sys_ctrl/Kconfig.inc"

orsource "template_ctrl/Kconfig.inc"
```

## components/cli_ctrl/Kconfig.inc
```kconfig
menu "CLI Controller"

    config CLI_CTRL_ENABLE
        bool "Enable CLI Controller"
        default "n"
        help
            Enable CLI Controller to use by the Manager

    choice CLI_CTRL_LOG_LEVEL
        depends on CLI_CTRL_ENABLE
        bool "Log level"
        default CLI_CTRL_LOG_DEFAULT_LEVEL_INFO
        help
            Specify how much output to see in logs by default.
            You can set lower verbosity level at runtime using
            esp_log_level_set() function if LOG_DYNAMIC_LEVEL_CONTROL
            is enabled.

            By default, this setting limits which log statements
            are compiled into the program. For example, selecting
            "Warning" would mean that changing log level to "Debug"
            at runtime will not be possible. To allow increasing log
            level above the default at runtime, see the next option.

        config CLI_CTRL_LOG_DEFAULT_LEVEL_NONE
            bool "No output"
        config CLI_CTRL_LOG_DEFAULT_LEVEL_ERROR
            bool "Error"
        config CLI_CTRL_LOG_DEFAULT_LEVEL_WARN
            bool "Warning"
        config CLI_CTRL_LOG_DEFAULT_LEVEL_INFO
            bool "Info"
        config CLI_CTRL_LOG_DEFAULT_LEVEL_DEBUG
            bool "Debug"
        config CLI_CTRL_LOG_DEFAULT_LEVEL_VERBOSE
            bool "Verbose"
    endchoice

    config CLI_CTRL_LOG_LEVEL
        depends on CLI_CTRL_ENABLE
        int
        default 0 if CLI_CTRL_LOG_DEFAULT_LEVEL_NONE
        default 1 if CLI_CTRL_LOG_DEFAULT_LEVEL_ERROR
        default 2 if CLI_CTRL_LOG_DEFAULT_LEVEL_WARN
        default 3 if CLI_CTRL_LOG_DEFAULT_LEVEL_INFO
        default 4 if CLI_CTRL_LOG_DEFAULT_LEVEL_DEBUG
        default 5 if CLI_CTRL_LOG_DEFAULT_LEVEL_VERBOSE

endmenu
```

## components/eth_ctrl/Kconfig.inc
```kconfig
menu "ETH Controller"

    config ETH_CTRL_ENABLE
        bool "Enable Ethernet Controller"
        default "y"
        help
            Enable Ethernet Controller to use by the Manager

    choice ETH_CTRL_LOG_LEVEL
        depends on ETH_CTRL_ENABLE
        bool "Log level"
        default ETH_CTRL_LOG_DEFAULT_LEVEL_INFO
        help
            Specify how much output to see in logs by default.
            You can set lower verbosity level at runtime using
            esp_log_level_set() function if LOG_DYNAMIC_LEVEL_CONTROL
            is enabled.

            By default, this setting limits which log statements
            are compiled into the program. For example, selecting
            "Warning" would mean that changing log level to "Debug"
            at runtime will not be possible. To allow increasing log
            level above the default at runtime, see the next option.

        config ETH_CTRL_LOG_DEFAULT_LEVEL_NONE
            bool "No output"
        config ETH_CTRL_LOG_DEFAULT_LEVEL_ERROR
            bool "Error"
        config ETH_CTRL_LOG_DEFAULT_LEVEL_WARN
            bool "Warning"
        config ETH_CTRL_LOG_DEFAULT_LEVEL_INFO
            bool "Info"
        config ETH_CTRL_LOG_DEFAULT_LEVEL_DEBUG
            bool "Debug"
        config ETH_CTRL_LOG_DEFAULT_LEVEL_VERBOSE
            bool "Verbose"
    endchoice

    config ETH_CTRL_LOG_LEVEL
        depends on ETH_CTRL_ENABLE
        int
        default 0 if ETH_CTRL_LOG_DEFAULT_LEVEL_NONE
        default 1 if ETH_CTRL_LOG_DEFAULT_LEVEL_ERROR
        default 2 if ETH_CTRL_LOG_DEFAULT_LEVEL_WARN
        default 3 if ETH_CTRL_LOG_DEFAULT_LEVEL_INFO
        default 4 if ETH_CTRL_LOG_DEFAULT_LEVEL_DEBUG
        default 5 if ETH_CTRL_LOG_DEFAULT_LEVEL_VERBOSE

endmenu
```

## components/lcd_ctrl/Kconfig.inc
```kconfig
menu "LCD Controller"

    config LCD_CTRL_ENABLE
        bool "Enable LCD Controller"
        default "n"
        help
            Enable LCD Controller to use by the Manager

    choice LCD_CTRL_LOG_LEVEL
        bool "LCD Controller Log level"
        default LCD_CTRL_LOG_DEFAULT_LEVEL_INFO
        help
            Specify how much output to see in logs by default.

        config LCD_CTRL_LOG_DEFAULT_LEVEL_NONE
            bool "No output"
        config LCD_CTRL_LOG_DEFAULT_LEVEL_ERROR
            bool "Error"
        config LCD_CTRL_LOG_DEFAULT_LEVEL_WARN
            bool "Warning"
        config LCD_CTRL_LOG_DEFAULT_LEVEL_INFO
            bool "Info"
        config LCD_CTRL_LOG_DEFAULT_LEVEL_DEBUG
            bool "Debug"
        config LCD_CTRL_LOG_DEFAULT_LEVEL_VERBOSE
            bool "Verbose"
    endchoice

    choice LCD_HELPER_LOG_LEVEL
        bool "LCD Helper Log level"
        default LCD_HELPER_LOG_DEFAULT_LEVEL_INFO
        help
            Specify how much output to see in logs by default.

        config LCD_HELPER_LOG_DEFAULT_LEVEL_NONE
            bool "No output"
        config LCD_HELPER_LOG_DEFAULT_LEVEL_ERROR
            bool "Error"
        config LCD_HELPER_LOG_DEFAULT_LEVEL_WARN
            bool "Warning"
        config LCD_HELPER_LOG_DEFAULT_LEVEL_INFO
            bool "Info"
        config LCD_HELPER_LOG_DEFAULT_LEVEL_DEBUG
            bool "Debug"
        config LCD_HELPER_LOG_DEFAULT_LEVEL_VERBOSE
            bool "Verbose"
    endchoice

    choice LCD_HW_LOG_LEVEL
        bool "LCD HW Log level"
        default LCD_HW_LOG_DEFAULT_LEVEL_INFO
        help
            Specify how much output to see in logs by default.

        config LCD_HW_LOG_DEFAULT_LEVEL_NONE
            bool "No output"
        config LCD_HW_LOG_DEFAULT_LEVEL_ERROR
            bool "Error"
        config LCD_HW_LOG_DEFAULT_LEVEL_WARN
            bool "Warning"
        config LCD_HW_LOG_DEFAULT_LEVEL_INFO
            bool "Info"
        config LCD_HW_LOG_DEFAULT_LEVEL_DEBUG
            bool "Debug"
        config LCD_HW_LOG_DEFAULT_LEVEL_VERBOSE
            bool "Verbose"
    endchoice

    choice LCD_ILI9341V_LOG_LEVEL
        bool "LCD ILI9341V Log level"
        default LCD_ILI9341V_LOG_DEFAULT_LEVEL_INFO
        help
            Specify how much output to see in logs by default.

        config LCD_ILI9341V_LOG_DEFAULT_LEVEL_NONE
            bool "No output"
        config LCD_ILI9341V_LOG_DEFAULT_LEVEL_ERROR
            bool "Error"
        config LCD_ILI9341V_LOG_DEFAULT_LEVEL_WARN
            bool "Warning"
        config LCD_ILI9341V_LOG_DEFAULT_LEVEL_INFO
            bool "Info"
        config LCD_ILI9341V_LOG_DEFAULT_LEVEL_DEBUG
            bool "Debug"
        config LCD_ILI9341V_LOG_DEFAULT_LEVEL_VERBOSE
            bool "Verbose"
    endchoice

    choice LCD_NS2009_LOG_LEVEL
        bool "LCD NS2009 Log level"
        default LCD_NS2009_LOG_DEFAULT_LEVEL_INFO
        help
            Specify how much output to see in logs by default.

        config LCD_NS2009_LOG_DEFAULT_LEVEL_NONE
            bool "No output"
        config LCD_NS2009_LOG_DEFAULT_LEVEL_ERROR
            bool "Error"
        config LCD_NS2009_LOG_DEFAULT_LEVEL_WARN
            bool "Warning"
        config LCD_NS2009_LOG_DEFAULT_LEVEL_INFO
            bool "Info"
        config LCD_NS2009_LOG_DEFAULT_LEVEL_DEBUG
            bool "Debug"
        config LCD_NS2009_LOG_DEFAULT_LEVEL_VERBOSE
            bool "Verbose"
    endchoice

    config LCD_CTRL_LOG_LEVEL
        int
        default 0 if LCD_CTRL_LOG_DEFAULT_LEVEL_NONE
        default 1 if LCD_CTRL_LOG_DEFAULT_LEVEL_ERROR
        default 2 if LCD_CTRL_LOG_DEFAULT_LEVEL_WARN
        default 3 if LCD_CTRL_LOG_DEFAULT_LEVEL_INFO
        default 4 if LCD_CTRL_LOG_DEFAULT_LEVEL_DEBUG
        default 5 if LCD_CTRL_LOG_DEFAULT_LEVEL_VERBOSE

    config LCD_HELPER_LOG_LEVEL
        int
        default 0 if LCD_HELPER_LOG_DEFAULT_LEVEL_NONE
        default 1 if LCD_HELPER_LOG_DEFAULT_LEVEL_ERROR
        default 2 if LCD_HELPER_LOG_DEFAULT_LEVEL_WARN
        default 3 if LCD_HELPER_LOG_DEFAULT_LEVEL_INFO
        default 4 if LCD_HELPER_LOG_DEFAULT_LEVEL_DEBUG
        default 5 if LCD_HELPER_LOG_DEFAULT_LEVEL_VERBOSE

    config LCD_HW_LOG_LEVEL
        int
        default 0 if LCD_HW_LOG_DEFAULT_LEVEL_NONE
        default 1 if LCD_HW_LOG_DEFAULT_LEVEL_ERROR
        default 2 if LCD_HW_LOG_DEFAULT_LEVEL_WARN
        default 3 if LCD_HW_LOG_DEFAULT_LEVEL_INFO
        default 4 if LCD_HW_LOG_DEFAULT_LEVEL_DEBUG
        default 5 if LCD_HW_LOG_DEFAULT_LEVEL_VERBOSE

    config LCD_ILI9341V_LOG_LEVEL
        int
        default 0 if LCD_ILI9341V_LOG_DEFAULT_LEVEL_NONE
        default 1 if LCD_ILI9341V_LOG_DEFAULT_LEVEL_ERROR
        default 2 if LCD_ILI9341V_LOG_DEFAULT_LEVEL_WARN
        default 3 if LCD_ILI9341V_LOG_DEFAULT_LEVEL_INFO
        default 4 if LCD_ILI9341V_LOG_DEFAULT_LEVEL_DEBUG
        default 5 if LCD_ILI9341V_LOG_DEFAULT_LEVEL_VERBOSE

    config LCD_NS2009_LOG_LEVEL
        int
        default 0 if LCD_NS2009_LOG_DEFAULT_LEVEL_NONE
        default 1 if LCD_NS2009_LOG_DEFAULT_LEVEL_ERROR
        default 2 if LCD_NS2009_LOG_DEFAULT_LEVEL_WARN
        default 3 if LCD_NS2009_LOG_DEFAULT_LEVEL_INFO
        default 4 if LCD_NS2009_LOG_DEFAULT_LEVEL_DEBUG
        default 5 if LCD_NS2009_LOG_DEFAULT_LEVEL_VERBOSE


endmenu
```

## components/template_ctrl/Kconfig.inc
```kconfig
menu "Template Controller"

    config TEMPLATE_CTRL_ENABLE
        bool "Enable Template Controller"
        default "n"
        help
            Enable Template Controller to use by the Manager

    choice TEMPLATE_CTRL_LOG_LEVEL
        depends on TEMPLATE_CTRL_ENABLE
        bool "Log level"
        default TEMPLATE_CTRL_LOG_DEFAULT_LEVEL_INFO
        help
            Specify how much output to see in logs by default.
            You can set lower verbosity level at runtime using
            esp_log_level_set() function if LOG_DYNAMIC_LEVEL_CONTROL
            is enabled.

            By default, this setting limits which log statements
            are compiled into the program. For example, selecting
            "Warning" would mean that changing log level to "Debug"
            at runtime will not be possible. To allow increasing log
            level above the default at runtime, see the next option.

        config TEMPLATE_CTRL_LOG_DEFAULT_LEVEL_NONE
            bool "No output"
        config TEMPLATE_CTRL_LOG_DEFAULT_LEVEL_ERROR
            bool "Error"
        config TEMPLATE_CTRL_LOG_DEFAULT_LEVEL_WARN
            bool "Warning"
        config TEMPLATE_CTRL_LOG_DEFAULT_LEVEL_INFO
            bool "Info"
        config TEMPLATE_CTRL_LOG_DEFAULT_LEVEL_DEBUG
            bool "Debug"
        config TEMPLATE_CTRL_LOG_DEFAULT_LEVEL_VERBOSE
            bool "Verbose"
    endchoice

    config TEMPLATE_CTRL_LOG_LEVEL
        depends on TEMPLATE_CTRL_ENABLE
        int
        default 0 if TEMPLATE_CTRL_LOG_DEFAULT_LEVEL_NONE
        default 1 if TEMPLATE_CTRL_LOG_DEFAULT_LEVEL_ERROR
        default 2 if TEMPLATE_CTRL_LOG_DEFAULT_LEVEL_WARN
        default 3 if TEMPLATE_CTRL_LOG_DEFAULT_LEVEL_INFO
        default 4 if TEMPLATE_CTRL_LOG_DEFAULT_LEVEL_DEBUG
        default 5 if TEMPLATE_CTRL_LOG_DEFAULT_LEVEL_VERBOSE

endmenu
```

## drivers/tsl2561/Kconfig
```kconfig
menu "TSL2561 driver"

    config TSL2561_ENABLE
        bool "Enable TSL2561"
        default "n"
        help
            Enable TSL2561 to use by repository components.


    if TSL2561_ENABLE
        config TSL2561_PORT_NUMBER
            int "Port number"
            range 0 1
            default 0 if IDF_TARGET_ESP32
            default 0 if IDF_TARGET_ESP32S3
            default 0 if IDF_TARGET_ESP32S2
            help
                Set port number used by TSL-2561.

        config TSL2561_SLAVE_ADDR
            int "Slave address"
            default 57 if IDF_TARGET_ESP32
            default 57 if IDF_TARGET_ESP32S3
            default 57 if IDF_TARGET_ESP32S2
            help
                Set port number used by TSL-2561.
                --------------
                |  Hex | Dec |
                +------+-----+
                | 0x39 |  57 | <- default
                | 0x29 |  41 |
                | 0x49 |  73 |
                --------------

        config TSL2561_I2C_CLK_FREQUENCY
            int "I2C clock frequency in kHz"
            range 0 400
            default 400 if IDF_TARGET_ESP32
            default 400 if IDF_TARGET_ESP32S3
            default 400 if IDF_TARGET_ESP32S2
            help
                Set clock frequency used by TSL-2561.

        config TSL2561_SDA_GPIO
            int "SDA GPIO number"
            range 0 39
            default 13 if IDF_TARGET_ESP32
            default 21 if IDF_TARGET_ESP32S3
            default 21 if IDF_TARGET_ESP32S2
            help
                Set the GPIO number used by TSL-2561 SDA.

        config TSL2561_SCL_GPIO
            int "SCL GPIO number"
            range 0 39
            default 16 if IDF_TARGET_ESP32
            default 17 if IDF_TARGET_ESP32S3
            default 17 if IDF_TARGET_ESP32S2
            help
                Set the GPIO number used by TSL-2561 SCL.

        config TSL2561_INT_GPIO
            int "INT GPIO number"
            range 0 39
            default 36 if IDF_TARGET_ESP32
            default 16 if IDF_TARGET_ESP32S3
            default 16 if IDF_TARGET_ESP32S2
            help
                Set the GPIO number used by TSL-2561 INT.

        choice TSL2561_LOG_LEVEL
            bool "Log level"
            default TSL2561_LOG_DEFAULT_LEVEL_INFO
            help
                Specify how much output to see in logs by default.

            config TSL2561_LOG_DEFAULT_LEVEL_NONE
                bool "No output"
            config TSL2561_LOG_DEFAULT_LEVEL_ERROR
                bool "Error"
            config TSL2561_LOG_DEFAULT_LEVEL_WARN
                bool "Warning"
            config TSL2561_LOG_DEFAULT_LEVEL_INFO
                bool "Info"
            config TSL2561_LOG_DEFAULT_LEVEL_DEBUG
                bool "Debug"
            config TSL2561_LOG_DEFAULT_LEVEL_VERBOSE
                bool "Verbose"
        endchoice

        config TSL2561_LOG_LEVEL
            int
            default 0 if TSL2561_LOG_DEFAULT_LEVEL_NONE
            default 1 if TSL2561_LOG_DEFAULT_LEVEL_ERROR
            default 2 if TSL2561_LOG_DEFAULT_LEVEL_WARN
            default 3 if TSL2561_LOG_DEFAULT_LEVEL_INFO
            default 4 if TSL2561_LOG_DEFAULT_LEVEL_DEBUG
            default 5 if TSL2561_LOG_DEFAULT_LEVEL_VERBOSE

    endif # TSL2561_ENABLE
    
endmenu
```
